## source/sdkconfig.defaults
```kconfig
# Minimal ESP32-S3 Defaults for USB Tonex Footswitch Controller
CONFIG_IDF_TARGET_ARCH_XTENSA=y
CONFIG_IDF_TARGET_ARCH="xtensa"
CONFIG_IDF_TARGET="esp32s3"
CONFIG_IDF_TARGET_ESP32S3=y
CONFIG_COMPILER_OPTIMIZATION_PERF=y

# Disable Bluetooth to save Flash & RAM
CONFIG_BT_ENABLED=n

# Disable HTTP server
# CONFIG_HTTPD_WS_SUPPORT is not set

# SPIRAM configuration
CONFIG_SPIRAM=y
CONFIG_SPIRAM_RODATA=y
CONFIG_SPIRAM_SPEED_80M=y
CONFIG_FREERTOS_HZ=1000

# USB Host Settings
CONFIG_USB_HOST_CONTROL_TRANSFER_MAX_SIZE=2048
CONFIG_USB_HOST_HUBS_SUPPORTED=y
CONFIG_USB_HOST_HUB_MULTI_LEVEL=n

# Watchdog & system
CONFIG_ESP_INT_WDT_TIMEOUT_MS=3000
CONFIG_ESP_TASK_WDT_PANIC=n
CONFIG_ESP_TASK_WDT_TIMEOUT_S=10

CONFIG_TONEX_CONTROLLER_ENABLE_MIDI_THRU=n
CONFIG_TONEX_CONTROLLER_HARDWARE_SUBVARIANT_NONE=y
```
